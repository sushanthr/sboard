## config/boards/shields/sboard/Kconfig.defconfig
```kconfig
if SHIELD_SBOARD_LEFT

config ZMK_KEYBOARD_NAME
    default "sboard"

config ZMK_SPLIT_ROLE_CENTRAL
    default y

endif

if SHIELD_SBOARD_LEFT || SHIELD_SBOARD_RIGHT

config ZMK_SPLIT
    default y

config ZMK_SPLIT_BLE
    default y

endif
```
